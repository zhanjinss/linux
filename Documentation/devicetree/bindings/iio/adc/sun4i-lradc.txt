## Documentation/devicetree/bindings/iio/adc/sun4i-lradc.txt
```
Allwinner sun4i Low Resolution ADC
----------------------------------

Required properties:
 - compatible: "allwinner,sun4i-a10-lradc"
 - reg: mmio address range of the chip
 - interrupts: interrupt to which the chip is connected
 - vref-supply: powersupply for the lradc reference voltage
 - #io-channel-cells = <1>; As ADC has multiple outputs

Example:

	lradc: lradc@01c22800 {
		compatible = "allwinner,sun4i-a10-lradc";
		reg = <0x01c22800 0x100>;
		interrupts = <31>;
		vref-supply = <&reg_vcc3v0>;
		#io-channel-cells = <1>;
	};
```

## Documentation/devicetree/bindings/pwm/atmel-tcb-pwm.txt
```
Atmel TCB PWM controller

Required properties:
- compatible: should be "atmel,tcb-pwm"
- reg: tcb channel to use. Each channel can export 2 PWMs
- #pwm-cells: should be 3. See pwm.txt in this directory for a description of
  the cells format. The only third cell flag supported by this binding is
  PWM_POLARITY_INVERTED.

Example:

tcb0: timer@f800c000 {
	pwm@0 {
		compatible = "atmel,tcb-pwm";
		reg = <0>;
		#pwm-cells = <3>;
	};
};
```

## arch/arm/pie/Kconfig
```kconfig
config PIE
	bool
	help
	  This option adds support for embedding position indepentant (PIE)
	  executables into the kernel. The PIEs can then be copied into
	  genalloc regions such as SRAM and executed. Some platforms require
	  this for suspend/resume support.
```
